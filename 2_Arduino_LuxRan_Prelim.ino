const int ledPin = 13; // The pin connected to your LED
const int ldrPin = A0;  // The pin connected to your LDR

void setup() {
  Serial.begin(9600);
  
  // Set Pin 13 as an output and turn it ON
  pinMode(ledPin, OUTPUT);
  digitalWrite(ledPin, HIGH); 
  
  pinMode(ldrPin, INPUT);
  
  Serial.println("--- LuxCrypt TRNG Initialized ---");
}

void loop() {
  String bitString = "";

  // Generate 8 bits to form a byte every second
  for (int i = 0; i < 8; i++) {
    int bit = generateBit();
    bitString += String(bit);
    delay(125); 
  }

  Serial.print("Generated Byte: ");
  Serial.println(bitString);
}

int generateBit() {
  int val1 = analogRead(ldrPin);
  delay(5); // Shift this to 5ms for faster polling
  int val2 = analogRead(ldrPin);

  if (val1 > val2) return 1;
  if (val1 < val2) return 0;
  
  // If they are equal, return a "random" guess (0) 
  // rather than restarting the whole function.
  // This breaks the loop and lets the code print!
  return 0; 
}